// Miryoku (QWERTY) for a classic Corne with nice!nano v2 controllers
// (ZMK shields corne_left / corne_right on board nice_nano//zmk).
// Miryoku: Copyright 2021 Manna Harbour, https://github.com/manna-harbour/miryoku
//
// Same layout as blecorne.keymap: 36 Miryoku keys on the 5-column layout.
// Options (alphas, clipboard, nav style...) live in config/miryoku/custom_config.h.

#include "miryoku/custom_config.h"
#include "miryoku/mapping/36/corne_5col.h"
#include "miryoku/miryoku.dtsi"

/ {
    chosen {
        zmk,physical-layout = &foostan_corne_5col_layout;
    };
};

// Only the 36-key layout exists in this firmware. The board also defines the 42-key "6 Column"
// layout; with ZMK Studio the left half remembers which layout was last selected (also from
// older firmware), and a left half on 6 columns with a right half on 5 columns scrambles the
// right-hand keys. Removing the 6-column layout (and its position map) rules that out.
/delete-node/ &foostan_corne_6col_posmap;
/delete-node/ &foostan_corne_6col_layout;
