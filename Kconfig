## Kconfig
```kconfig
config ZMK_BEHAVIOR_LAYER_SYNC
    bool
    default y
    depends on DT_HAS_ZMK_BEHAVIOR_LAYER_SYNC_ENABLED
```

## dts/bindings/behaviors/zmk,behavior-layer-sync.yaml
```yaml
# SPDX-License-Identifier: MIT
description: |
  Momentary layer (like &mo) that is also run on split peripherals, so they can
  show the held layer. The layer is only activated on the central.

compatible: "zmk,behavior-layer-sync"

include: one_param.yaml
```
